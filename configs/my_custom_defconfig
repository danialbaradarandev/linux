## configs/my_custom_defconfig
```kconfig
BR2_x86_64=y
BR2_TOOLCHAIN_BUILDROOT=y
BR2_TOOLCHAIN_BUILDROOT_GLIBC=y
BR2_PACKAGE_BUSYBOX=y
BR2_ROOTFS_EXT2=y
BR2_TARGET_ROOTFS_EXT2_SIZE="512M"
BR2_LINUX_KERNEL=y
BR2_LINUX_KERNEL_DEFCONFIG="defconfig"
BR2_PACKAGE_XORG7=y
BR2_PACKAGE_XF86_VIDEO_FBDEV=y
BR2_PACKAGE_XFCE=y
BR2_PACKAGE_XFCE4_TERMINAL=y
BR2_LINUX_KERNEL_DEFCONFIG="defconfig"
```
